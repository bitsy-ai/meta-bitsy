## conf/distro/bitsy.conf
```bitbake
require conf/distro/include/rpi.inc
require conf/distro/include/no-static-libs.inc
require conf/distro/include/security_flags.inc
require conf/distro/include/swupdate.inc
require conf/distro/include/rust_versions.inc

require conf/machine/${MACHINE}-extra.conf

DISTRO ?= "bitsy"
DISTRO_NAME ?= "BitsyLinux"
YOCTO_VERSION = "4.1.2"
YOCTO_CODENAME = "Mickledore"
DISTRO_VERSION ?= "0.1.0"
DISTRO_CODENAME ?= "Amber"
SDK_VENDOR = "-bitsysdk"
SDK_VERSION = "${@d.getVar('DISTRO_VERSION').replace('snapshot-${METADATA_REVISION}', 'snapshot')}"
SDK_VERSION[vardepvalue] = "${SDK_VERSION}"
HOME_URL = "https://linux.bitsy.ai"
BUG_REPORT_URL = "https://github.com/bitsy-ai/meta-bitsy/issues"
DISTRO_PRETTY = "${DISTRO_NAME} ${DISTRO_VERSION}${@' (%s)' % DISTRO_CODENAME if 'DISTRO_CODENAME' in d else ''}"
OS_RELEASE_FIELDS = "\
    ID ID_LIKE BUILD_ID NAME VERSION VERSION_ID PRETTY_NAME DISTRO_CODENAME \
    HOME_URL BUG_REPORT_URL YOCTO_VERSION YOCTO_CODENAME SDK_VERSION VARIANT VARIANT_ID \
"
BUILD_ID = "${@time.strftime('%Y-%m-%dT%H:%M:%SZ',time.localtime())}"

MAINTAINER = "Leigh Johnson <leigh@bitsy.ai>"

TARGET_VENDOR = "-bitsy"
LOCALCONF_VERSION = "2"

BITSY_DEFAULT_DISTRO_FEATURES = "acl argp bitsy-growpart overlayfs bluetooth ext4 ipv4 ipv6 keyboard largefile overlayfs nginx seccomp swupdate systemd usbgadget usbhost vfat wifi xattrs zeroconf"

LICENSE = "AGPLv3"
DESCRIPTION = "A console-only image with read-only root filesystem and writeable data partition"

BITSY_DEFAULT_EXTRA_RDEPENDS = ""

BITSY_DEFAULT_EXTRA_RRECOMMENDS = "kernel-module-af-packet"
DISTRO_FEATURES ?= "${DISTRO_FEATURES_DEFAULT} ${BITSY_DEFAULT_DISTRO_FEATURES}"

# EXTRA_IMAGE_FEATURES += "ptest-pkgs"

PREFERRED_VERSION_linux-raspberrypi = "5.15.%"


SDK_NAME = "${DISTRO}-${TCLIBC}-${SDKMACHINE}-${IMAGE_BASENAME}-${TUNE_PKGARCH}-${MACHINE}"
SDKPATHINSTALL = "/opt/${DISTRO}/${SDK_VERSION}"

DISTRO_EXTRA_RDEPENDS  += "${BITSY_DEFAULT_EXTRA_RDEPENDS}"
DISTRO_EXTRA_RRECOMMENDS += "${BITSY_DEFAULT_EXTRA_RRECOMMENDS}"

BB_SIGNATURE_HANDLER ?= "OEEquivHash"
BB_HASHSERVE ??= "auto"
TCLIBCAPPEND = ""

# Use systemd for system initialization
DISTRO_FEATURES:append = " systemd"
DISTRO_FEATURES_BACKFILL_CONSIDERED:append = " sysvinit"
VIRTUAL-RUNTIME_init_manager = "systemd"
VIRTUAL-RUNTIME_initscripts = "systemd-compat-units"
VIRTUAL-RUNTIME_login_manager = "shadow-base"
VIRTUAL-RUNTIME_dev_manager = "systemd"
INHERIT += "issue-txt"

DISTROOVERRIDES = "bitsy"



PREFERRED_VERSION_cargo = "1.66.%"
PREFERRED_VERSION_cross-canadian = "1.66.%"
PREFERRED_VERSION_libstd-rs = "1.66.%"
PREFERRED_VERSION_llvm = "1.66.%"
PREFERRED_VERSION_rust = "1.66.%"
PREFERRED_VERSION_rust-native = "1.66.%"
```

## conf/distro/include/rpi.inc
```bitbake
#
# Customizations: meta-raspberrypi
# https://github.com/agherzan/meta-raspberrypi/blob/master/docs/extra-build-config.md
# v4l2 drivers
VIDEO_CAMERA = "1"
RPI_USE_U_BOOT = "1"
ENABLE_SPI_BUS = "1"
ENABLE_I2C = "1"
ENABLE_UART = "1"
INITRAMFS_IMAGE_BUNDLE = "1"

GPU_MEM = "128"
GPU_MEM_256 = "128"
GPU_MEM_512 = "384"
GPU_MEM_1024 = "512"
```

## conf/distro/include/swupdate.inc
```bitbake
BITSY_ROOTFS_COPY1_DEVICE = "/dev/mmcblk0p2"
BITSY_ROOTFS_COPY2_DEVICE = "/dev/mmcblk0p3"
```

## conf/layer.conf
```bitbake
# We have a conf and classes directory, add to BBPATH
BBPATH .= ":${LAYERDIR}"

# We have recipes-* directories, add to BBFILES
BBFILES += "${LAYERDIR}/recipes-*/*/*.bb \
            ${LAYERDIR}/recipes-*/*/*.bbappend"

BBFILE_COLLECTIONS += "bitsy"
BBFILE_PATTERN_bitsy = "^${LAYERDIR}/"
BBFILE_PRIORITY_bitsy = "10" 
# must be higher than meta-raspberrypi

LAYERDEPENDS_bitsy += "core"

LAYERSERIES_COMPAT_bitsy = "kirkstone langdale mickledore"
```

## conf/machine/bitsy-raspberrypi4-64.conf
```bitbake
require conf/machine/raspberrypi4-64.conf

INHERIT += "image-buildinfo"
IMAGE_BUILDINFO_FILE = "${DEPLOYDIR}/${BOOTFILES_DIR_NAME}/issue.txt"
BUILD_ID = "${@time.strftime('%Y-%m-%d %H:%M:%S',time.localtime())}"
IMAGE_BUILDINFO_VARS:append = " DATETIME DISTRO_NAME IMAGE_BASENAME MACHINE TUNE_PKGARCH" 
IMAGE_BUILDINFO_VARS:append = " MACHINE_FEATURES DISTRO_FEATURES COMMON_FEATURES IMAGE_FEATURES"
IMAGE_BUILDINFO_VARS:append = " TUNE_FEATURES TARGET_FPU"
```

## meta-octoprint/conf/layer.conf
```bitbake
# We have a conf and classes directory, add to BBPATH
BBPATH .= ":${LAYERDIR}"

# We have recipes-* directories, add to BBFILES
BBFILES += "${LAYERDIR}/recipes-*/*/*.bb \
            ${LAYERDIR}/recipes-*/*/*.bbappend"

BBFILE_COLLECTIONS += "octoprint"
BBFILE_PATTERN_octoprint = "^${LAYERDIR}/"
BBFILE_PRIORITY_octoprint = "6"

LAYERDEPENDS_octoprint = "core"
LAYERSERIES_COMPAT_octoprint = "dunfell honister"
```

## meta-printnanny/conf/distro/apps.conf
```bitbake
#
# PrintNanny embedded tools
#
IMAGE_INSTALL:append = " printnanny-core"

#
# Janus Gateway
#
IMAGE_INSTALL:append = " janus-gateway"
PACKAGECONFIG:janus-gateway = "rest rest_api websockets unix_sockets plugin_videoroom plugin_echo datachannels"

#
# Gstreamer
#
LICENSE_FLAGS_ACCEPTED += "commercial_gstreamer1.0-omx"
IMAGE_INSTALL:append = " gstreamer1.0"

#
# nnstreamer
#
# IMAGE_INSTALL:append = " nnstreamer"

#
# tensorflow-lite
#
# PREFERRED_VERSION:tensorflow-lite = "2.6.1"
# IMAGE_INSTALL:append = " tensorflow-lite"

#
# sysupdate + init
#
IMAGE_INSTALL:append = " bitsy-sysupdate"
```

## meta-printnanny/conf/distro/include/printnanny-os.inc
```bitbake
require conf/distro/poky.conf
require conf/distro/include/rpi.inc

DISTRO = "printnanny"
DISTRO_NAME = "PrintNanny OS (3D Print Assistant)"
DISTRO_VERSION = "0.1.0"
DISTRO_CODENAME = "alpha"
HOSTOS_VERSION = "${DISTRO_VERSION}"
SDK_VENDOR = "-printnannysdk"
SDK_VERSION = "${@d.getVar('DISTRO_VERSION').replace('snapshot-${METADATA_REVISION}', 'snapshot')}"
SDK_VERSION[vardepvalue] = "${SDK_VERSION}"

MAINTAINER = "Leigh Johnson <leigh@printnanny.ai>"

# strip out unneeded features
POKY_DEFAULT_DISTRO_FEATURES:remove = "wayland"
DISTRO_FEATURES_DEFAULT:remove = "x11"
DISTRO_FEATURES:remove = "pam"
DISTRO_FEATURES:append = " systemd"

TARGET_VENDOR = "-printnanny"
LOCALCONF_VERSION = "2"
# load PrintNanny image classes
# https://docs.yoctoproject.org/4.0.1/ref-manual/variables.html?highlight=image_classes#term-IMAGE_CLASSES

INIT_MANAGER = "systemd"
DISTRO_EXTRA_RDEPENDS = "packagegroup-printnanny-core"
```

## meta-printnanny/conf/distro/mender.conf
```bitbake
# https://docs.mender.io/3.2/system-updates-yocto-project
MENDER_STORAGE_DEVICE = "/dev/mmcblk0"
MENDER_STORAGE_TOTAL_SIZE_MB = "2048"
MENDER_BOOT_PART_SIZE_MB = "48"
ARTIFACTIMG_FSTYPE = "ext4"
RPI_USE_U_BOOT = "1"
# https://docs.mender.io/3.2/system-updates-yocto-project/image-customization/features
MENDER_FEATURES_ENABLE += "\
    mender-client-install \
    mender-growfs-data \
    mender-growfs-data \
    mender-image \
    mender-image-sd \
    mender-persist-systemd-machine-id \
    mender-systemd \
    mender-uboot \
"
MENDER_FEATURES_DISABLE += "mender-grub mender-image-uefi"
IMAGE_INSTALL += "kernel-image kernel-devicetree"
MENDER_SERVER_URL = "https://mender.live.printnanny.ai"
# artifact name + signing
MENDER_ARTIFACT_NAME = "${DISTRO}-${YOCTO_VERSION}-${PV}"
# FILESEXTRAPATHS_prepend := "${THISDIR}/files:"
# SRC_URI_append = " file://artifact-verify-key.pem"
# IMAGE_FEATURES += "read-only-rootfs"

# remove geolocation inventory script, which sends network data to a third party (!?) and is enabled by default in mender-client
# https://docs.mender.io/3.2/system-updates-yocto-project/customize-mender#remove-the-mender-inventory-geolocation-script
PACKAGECONFIG:remove:pn-mender-client = " inventory-network-scripts"
```

## meta-printnanny/conf/distro/printnanny-mainsail.conf
```bitbake
require conf/distro/printnanny.conf

VARIANT="PrintNanny Mainsail Edition"
VARIANT_ID="printnanny-mainsail"
DISTROOVERRIDES = "printnanny:printnanny-mainsail"
```

## meta-printnanny/conf/distro/printnanny-octoprint.conf
```bitbake
require conf/distro/printnanny.conf

VARIANT="PrintNanny OctoPrint Edition"
VARIANT_ID="printnanny-octoprint"
# required by OctoPrint 1.8.1
PREFERRED_VERSION_python3-pyyaml = "5.4.1"
DISTROOVERRIDES = "printnanny:printnanny-octoprint"
```

## meta-printnanny/conf/distro/printnanny.conf
```bitbake
require conf/distro/bitsy.conf

DISTRO = "printnanny"
DISTRO_NAME = "PrintNanny Linux"
DISTRO_VERSION = "0.7.3"
DISTRO_CODENAME = "Garnet"
VERSION_CODENAME = "${DISTRO_CODENAME}"
ID_LIKE = "BitsyLinux"

BUG_REPORT_URL:printnanny = "https://github.com/bitsy-ai/printnanny-os/issues"
SUPPORT_URL = "https//printnanny.ai"
HOME_URL = "https://printnanny.ai"
PRIVACY_POLICY_URL = "https://printnanny.ai/privacy-policy"

OS_RELEASE_FIELDS:printnanny = "\
    ID ID_LIKE BUILD_ID NAME VERSION VERSION_ID PRETTY_NAME VERSION_CODENAME \
    HOME_URL BUG_REPORT_URL PRIVACY_POLICY_URL SUPPORT_URL \ 
    YOCTO_VERSION YOCTO_CODENAME SDK_VERSION VARIANT_NAME VARIANT_ID \
"

PRINTNANNY_DISTRO_FEATURES = "opengl tensorflow tensorflow-lite polkit"
DISTRO_FEATURES:append = " ${PRINTNANNY_DISTRO_FEATURES}"

FORTRAN:forcevariable = ",fortran"

DISTROOVERRIDES = "printnanny"
```

## meta-printnanny/conf/distro/rpi.conf
```bitbake
#
# Customizations: meta-raspberrypi
# https://github.com/agherzan/meta-raspberrypi/blob/master/docs/extra-build-config.md
# v4l2 drivers
VIDEO_CAMERA = "1"
# DISABLE_RPI_BOOT_LOGO = "1"
# RPI_USE_U_BOOT = "1"
# INITRAMFS_IMAGE_BUNDLE = "1"
# imx219 dt overlay
RASPBERRYPI_CAMERA_V2 = "1"
ENABLE_SPI_BUS = "1"
ENABLE_I2C = "1"
ENABLE_UART = "1"
KERNEL_MODULE_AUTOLOAD:rpi += "i2c-dev i2c-bcm2708"

# https://github.com/agherzan/meta-raspberrypi/blob/master/docs/extra-build-config.md
IMAGE_FSTYPES = "ext4 ext4.xz rpi-sdimg"
# IMAGE_FSTYPES = "ext4 ext4.xz"
SDIMG_ROOTFS_TYPE = "ext4"

#
# Raspberry Pi Imager writes cloud-init cloud-config file to /boot/user-data
#
IMAGE_INSTALL:append = " cloud-init"

# example fields written by Raspberry Pi Imager v1.7.2 
#cloud-config
# hostname: pn-05-24
# manage_etc_hosts: true
# packages:
# - avahi-daemon
# apt:
#   conf: |
#     Acquire {
#       Check-Date "false";
#     };

# users:
# - name: pi
#   groups: users,adm,dialout,audio,netdev,video,plugdev,cdrom,games,input,gpio,spi,i2c,render,sudo
#   shell: /bin/bash
#   lock_passwd: false
#   passwd: <snipped>
#   ssh_authorized_keys:
#     - ssh-rsa <snipped>
#   sudo: ALL=(ALL) NOPASSWD:ALL


# timezone: America/Los_Angeles
# runcmd:
# - sed -i 's/^s*REGDOMAIN=S*/REGDOMAIN=US/' /etc/default/crda || true
# - rm -f /etc/xdg/autostart/piwiz.desktop
# - localectl set-x11-keymap "us" pc105
# - setupcon -k --force || true
```

## meta-printnanny/conf/layer.conf
```bitbake
# We have a conf and classes directory, add to BBPATH
BBPATH .= ":${LAYERDIR}"

# We have recipes-* directories, add to BBFILES
BBFILES += "${LAYERDIR}/recipes-*/*/*.bb \
            ${LAYERDIR}/recipes-*/*/*.bbappend"

BBFILE_COLLECTIONS += "printnanny"
BBFILE_PATTERN_printnanny = "^${LAYERDIR}/"
BBFILE_PRIORITY_printnanny = "10"

LAYERDEPENDS_printnanny = "\
    bitsy \
    core \
    meta-initramfs \
    multimedia-layer \
    meta-microcontroller \
    meta-python \
    networking-layer \
    neuralnetwork \
    raspberrypi \
    swupdate \
    webserver \
    yocto \
"
LAYERSERIES_COMPAT_printnanny = "kirkstone langdale mickledore"
```

## meta-printnanny/wic/sdimage-printnanny.wks
```
# short-description: Create Raspberry Pi SD card image
# long-description: Creates a partitioned SD card image for use with
# Raspberry Pi. Boot files are located in the first vfat partition.

# noatime fstab option disables writing file access time to drive each time a file is opened
# this helps extend the lifetime of sd cards

# Root part UUID is for systemd-repart / repart.d identification, see systemd-repartd.bb
part /boot --source bootimg-partition --ondisk mmcblk0 --fstype=vfat --label boot --active --align 4096 --size 20
part / --source rootfs --ondisk mmcblk0 --fstype=ext4 --label root --align 4096 --fsoptions="defaults,noatime" --uuid="10d4e6f6-9d18-4bb8-b856-c2723d43791a"
part --source rootfs --ondisk mmcblk0 --fstype=ext4 --label root2 --align 4096 --fsoptions="defaults,noatime" --uuid="2589a229-912a-4ceb-9f7e-78eb536b894c"
part /data --size 256M --ondisk mmcblk0 --fstype=ext4 --label data --align 4096 --fsoptions="defaults,noatime" --uuid="712aaf9a-d6a8-4f59-9738-e652decef229"
```
